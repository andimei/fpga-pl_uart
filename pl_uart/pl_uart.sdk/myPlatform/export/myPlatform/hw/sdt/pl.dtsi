/ {
	amba_pl: amba_pl {
		ranges;
		compatible = "simple-bus";
		#address-cells = <1>;
		#size-cells = <1>;
		uart_fifo_axi_hw_0_axi_lite_slave: axi_lite_slave@40000000 {
			xlnx,rable = <0>;
			compatible = "xlnx,axi-lite-slave-1.0";
			status = "okay";
			clock-names = "S_AXI_ACLK";
			xlnx,ip-name = "axi_lite_slave";
			xlnx,edk-iptype = "PERIPHERAL";
			reg = <0x40000000 0x1000>;
			clocks = <&clkc 15>;
			xlnx,name = "uart_fifo_axi_hw_0_axi_lite_slave";
		};
	};
};
